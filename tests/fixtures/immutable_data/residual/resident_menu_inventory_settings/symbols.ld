PROVIDE(D_0044E468 = 4518072);
PROVIDE(D_800D26A4 = 2148366884);
PROVIDE(D_800D2A90 = 2148367888);
PROVIDE(D_800D35A8 = 2148365780);
PROVIDE(D_800D35B4 = 2148365792);
PROVIDE(D_800D35C0 = 2148365804);
PROVIDE(D_800D35C8 = 2148365812);
PROVIDE(D_800D35D4 = 2148365824);
PROVIDE(D_800D35D8 = 2148365828);
PROVIDE(D_800D35E4 = 2148365840);
PROVIDE(D_800D35F4 = 2148365856);
PROVIDE(D_800D35FC_de = 2148365864);
PROVIDE(D_800D3604_de = 2148365872);
PROVIDE(D_800D360C = 2148365880);
PROVIDE(D_800D3610 = 2148365884);
PROVIDE(D_800D3628 = 2148365908);
PROVIDE(D_800D36A0 = 2148366028);
PROVIDE(D_800D3A58 = 2148366980);
PROVIDE(D_800D3BBC = 2148367336);
PROVIDE(D_800D3C50 = 2148367484);
PROVIDE(D_800D3D98 = 2148367812);
PROVIDE(D_800D3DA8 = 2148367828);
PROVIDE(D_800D3DB8 = 2148367844);
PROVIDE(D_800D3E14_de = 2148367936);
PROVIDE(D_800E6074 = 2148425844);
PROVIDE(D_800E6090 = 2148425872);
PROVIDE(D_800E60E4 = 2148425956);
PROVIDE(D_800E6100 = 2148425984);
PROVIDE(D_800E611C = 2148426012);
PROVIDE(D_800E63BC = 2148426684);
PROVIDE(rw_menu_paged_func_8043D25C_de = 4477892);
PROVIDE(rw_menu_paged_func_8043EE5C_de = 4452304);
PROVIDE(rw_menu_paged_func_8043F040_de = 4452784);
PROVIDE(rw_menu_paged_func_8043F0C8_de = 4452920);
PROVIDE(rw_menu_paged_func_804402DC_de = 4457548);
PROVIDE(rw_menu_paged_func_804404A8_de = 4458008);
PROVIDE(rw_menu_paged_func_804415F4_de = 4462436);
PROVIDE(rw_menu_paged_func_80442064_de = 4465108);
PROVIDE(rw_menu_paged_func_8044208C_de = 4465148);
PROVIDE(rw_menu_paged_func_80442384_de = 4465908);
PROVIDE(rw_menu_paged_func_804433F8_de = 4470120);
PROVIDE(rw_menu_paged_func_804434E0_de = 4470352);
PROVIDE(rw_menu_paged_func_80443710_de = 4470912);
PROVIDE(rw_menu_paged_func_80443734_de = 4470948);
PROVIDE(rw_menu_paged_func_804438BC_de = 4471340);
PROVIDE(rw_menu_paged_func_80443C14_de = 4472196);
PROVIDE(rw_menu_paged_func_80443CD4_de = 4472388);
PROVIDE(rw_menu_paged_func_80443DD0_de = 4472640);
PROVIDE(rw_menu_paged_func_804441E4_de = 4473684);
PROVIDE(rw_menu_paged_func_8044421C_de = 4473740);
PROVIDE(rw_menu_paged_func_80444314_de = 4473988);
PROVIDE(rw_menu_paged_func_80444314_eu = 4470064);
PROVIDE(rw_menu_paged_func_804443C0_de = 4474160);
PROVIDE(rw_menu_paged_func_80444424_de = 4474260);
PROVIDE(rw_menu_paged_func_80444488_de = 4474360);
PROVIDE(rw_menu_paged_func_804444EC_de = 4474460);
PROVIDE(rw_menu_paged_func_80444548_de = 4474552);
PROVIDE(rw_menu_paged_func_804445AC_de = 4474652);
PROVIDE(rw_menu_paged_func_80444610_de = 4474752);
PROVIDE(rw_menu_paged_func_80444674_de = 4474852);
PROVIDE(rw_menu_paged_func_804446D8_de = 4474952);
PROVIDE(rw_menu_paged_func_8044472C_de = 4475036);
PROVIDE(rw_menu_paged_func_804447A0_de = 4475152);
PROVIDE(rw_menu_paged_func_804447F0_de = 4475232);
PROVIDE(rw_menu_paged_func_8044488C_de = 4475388);
PROVIDE(rw_menu_paged_func_80444920_de = 4475536);
PROVIDE(rw_menu_paged_func_80444988_de = 4475640);
PROVIDE(rw_menu_paged_func_804449EC_de = 4475740);
PROVIDE(rw_menu_paged_func_80444AB8_de = 4475944);
PROVIDE(rw_menu_paged_func_80444B1C_de = 4476044);
PROVIDE(rw_menu_paged_func_80444BE8_de = 4476248);
PROVIDE(rw_menu_paged_func_80444C34_de = 4476324);
PROVIDE(rw_menu_paged_func_80444C68_de = 4476376);
PROVIDE(rw_menu_paged_func_80444CF8_de = 4476520);
PROVIDE(rw_menu_paged_func_80444D50_de = 4476608);
PROVIDE(rw_menu_paged_func_80444D9C_de = 4476684);
PROVIDE(rw_menu_paged_func_80444E30_de = 4477440);
PROVIDE(rw_menu_paged_func_80444E70_de = 4477504);
PROVIDE(rw_menu_paged_func_80444E7C_de = 4479156);
PROVIDE(rw_menu_paged_func_80444EB4_de = 4479212);
PROVIDE(rw_menu_paged_func_80444EBC_de = 4479220);
PROVIDE(rw_menu_paged_func_80444EE8_de = 4479264);
PROVIDE(rw_menu_paged_func_80444F14_de = 4479308);
PROVIDE(rw_menu_paged_func_80444F40_de = 4479352);
PROVIDE(rw_menu_paged_func_80444F6C_de = 4479396);
PROVIDE(rw_menu_paged_func_80444F98_de = 4479440);
PROVIDE(rw_menu_paged_func_80445020_de = 4479576);
PROVIDE(rw_menu_paged_func_80445080_de = 4479672);
PROVIDE(rw_menu_paged_func_80445160_de = 4479896);
PROVIDE(rw_menu_paged_func_804451D0_de = 4480008);
PROVIDE(rw_menu_paged_func_8044524C_us_rev1 = 4477516);
PROVIDE(rw_menu_paged_func_80445288_us_rev1 = 4477576);
PROVIDE(rw_menu_paged_func_804452B0_de = 4480232);
PROVIDE(rw_menu_paged_func_804452C4_us_rev1 = 4477636);
PROVIDE(rw_menu_paged_func_80445304_us_rev1 = 4477700);
PROVIDE(rw_menu_paged_func_80445310_de = 4480328);
PROVIDE(rw_menu_paged_func_80445344_us_rev1 = 4477764);
PROVIDE(rw_menu_paged_func_80445384_us_rev1 = 4477828);
PROVIDE(rw_menu_paged_func_804453E0_us_rev1 = 4477920);
PROVIDE(rw_menu_paged_func_804453F0_de = 4480552);
PROVIDE(rw_menu_paged_func_80445494_de = 4480716);
PROVIDE(rw_menu_paged_func_804454B4_us_rev1 = 4478132);
PROVIDE(rw_menu_paged_func_80445504_de = 4480828);
PROVIDE(rw_menu_paged_func_80445544_us_rev1 = 4478276);
PROVIDE(rw_menu_paged_func_804455D4_us_rev1 = 4478420);
PROVIDE(rw_menu_paged_func_8044560C_de = 4481636);
PROVIDE(rw_menu_paged_func_8044569C_de = 4481780);
PROVIDE(rw_menu_paged_func_804456B8_de = 4481808);
PROVIDE(rw_menu_paged_func_80445704_us_rev1 = 4478724);
PROVIDE(rw_menu_paged_func_80445794_us_rev1 = 4478868);
PROVIDE(rw_menu_paged_func_80445824_us_rev1 = 4479012);
PROVIDE(rw_menu_paged_func_80445964_de = 4482484);
PROVIDE(rw_menu_paged_func_80445AB4_de = 4482820);
PROVIDE(rw_menu_paged_func_80445BC0_de = 4483088);
PROVIDE(rw_menu_paged_func_80445D6C_de = 4483516);
PROVIDE(rw_menu_paged_func_80445E04_de = 4483668);
PROVIDE(rw_menu_paged_func_80445EF4_de = 4483908);
PROVIDE(rw_menu_paged_func_80445FC8_us_rev1 = 4480968);
PROVIDE(rw_menu_paged_func_80446000_us_rev1 = 4481024);
PROVIDE(rw_menu_paged_func_80446048_us_rev1 = 4481096);
PROVIDE(rw_menu_paged_func_80446090_us_rev1 = 4481168);
PROVIDE(rw_menu_paged_func_804460C4_us_rev1 = 4481220);
PROVIDE(rw_menu_paged_func_8044610C_us_rev1 = 4481292);
PROVIDE(rw_menu_paged_func_80446140_us_rev1 = 4481344);
PROVIDE(rw_menu_paged_func_8044616C_us_rev1 = 4481388);
PROVIDE(rw_menu_paged_func_80446214_us_rev1 = 4481556);
PROVIDE(rw_menu_paged_func_80446230_us_rev1 = 4481584);
PROVIDE(rw_menu_paged_func_80446330_us_rev1 = 4481840);
