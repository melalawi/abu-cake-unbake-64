PROVIDE(D_0044E468 = 4518072);
PROVIDE(D_800D2480 = 2148366336);
PROVIDE(D_800D2A90 = 2148367888);
PROVIDE(D_800D3628 = 2148365908);
PROVIDE(D_800D365C = 2148365960);
PROVIDE(D_800D3660 = 2148365964);
PROVIDE(D_800D36A0 = 2148366028);
PROVIDE(D_800D36E4 = 2148366096);
PROVIDE(D_800D3748 = 2148366196);
PROVIDE(D_800D37A0 = 2148366284);
PROVIDE(D_800D37B0 = 2148366300);
PROVIDE(D_800D37C0 = 2148366316);
PROVIDE(D_800D37E4 = 2148366352);
PROVIDE(D_800D37F8 = 2148366372);
PROVIDE(D_800D393C = 2148366696);
PROVIDE(D_800D3958 = 2148366724);
PROVIDE(D_800D39DC = 2148366856);
PROVIDE(D_800D3A58 = 2148366980);
PROVIDE(D_800D3A9C = 2148367048);
PROVIDE(D_800D3B20 = 2148367180);
PROVIDE(D_800D3B28 = 2148367188);
PROVIDE(D_800D3B30 = 2148367196);
PROVIDE(D_800D3B38 = 2148367204);
PROVIDE(D_800D3B40 = 2148367212);
PROVIDE(D_800D3B48 = 2148367220);
PROVIDE(D_800D3B50 = 2148367228);
PROVIDE(D_800D3B58 = 2148367236);
PROVIDE(D_800D3B60 = 2148367244);
PROVIDE(D_800D3B68 = 2148367252);
PROVIDE(D_800D3B70 = 2148367260);
PROVIDE(D_800D3B78 = 2148367268);
PROVIDE(D_800D3B80 = 2148367276);
PROVIDE(D_800D3B88 = 2148367284);
PROVIDE(D_800D3C50 = 2148367484);
PROVIDE(D_800D3E14_de = 2148367936);
PROVIDE(D_800DE048_de = 2148409464);
PROVIDE(D_800DE7D4_eu_x = 2148366860);
PROVIDE(D_800E1BB8 = 2148424712);
PROVIDE(rw_menu_paged_func_80406434_de = 4219956);
PROVIDE(rw_menu_paged_func_804066BC_de = 4220604);
PROVIDE(rw_menu_paged_func_804069F4_de = 4221428);
PROVIDE(rw_menu_paged_func_80406F7C_de = 4222844);
PROVIDE(rw_menu_paged_func_804070F4_de = 4223220);
PROVIDE(rw_menu_paged_func_80407748_de = 4224840);
PROVIDE(rw_menu_paged_func_80407F6C_de = 4226924);
PROVIDE(rw_menu_paged_func_80408118_de = 4227352);
PROVIDE(rw_menu_paged_func_804082FC_de = 4227836);
PROVIDE(rw_menu_paged_func_804085E0_de = 4228576);
PROVIDE(rw_menu_paged_func_80408870_de = 4229232);
PROVIDE(rw_menu_paged_func_80408AC4_us = 4229828);
PROVIDE(rw_menu_paged_func_80408C4C_de = 4230264);
PROVIDE(rw_menu_paged_func_80408DF0_de = 4230684);
PROVIDE(rw_menu_paged_func_80409144_de = 4231536);
PROVIDE(rw_menu_paged_func_80409448_de = 4232308);
PROVIDE(rw_menu_paged_func_80409C0C_de = 4234296);
PROVIDE(rw_menu_paged_func_80409CEC_de = 4234520);
PROVIDE(rw_menu_paged_func_80409E10_de = 4234812);
PROVIDE(rw_menu_paged_func_8040A244_de = 4235888);
PROVIDE(rw_menu_paged_func_8040A458_de = 4236420);
PROVIDE(rw_menu_paged_func_8040A47C_de = 4236456);
PROVIDE(rw_menu_paged_func_8040A490_de = 4236476);
PROVIDE(rw_menu_paged_func_8040A4A0_de = 4236492);
PROVIDE(rw_menu_paged_func_8040A4D4_de = 4236544);
PROVIDE(rw_menu_paged_func_8040A530_de = 4236636);
PROVIDE(rw_menu_paged_func_8040A58C_de = 4236728);
PROVIDE(rw_menu_paged_func_8040A5E8_de = 4236820);
PROVIDE(rw_menu_paged_func_8040A614_de = 4236864);
PROVIDE(rw_menu_paged_func_8040A6A8_de = 4237012);
PROVIDE(rw_menu_paged_func_8040A6DC_de = 4237064);
PROVIDE(rw_menu_paged_func_8040A748_de = 4237172);
PROVIDE(rw_menu_paged_func_8040A764_de = 4237200);
PROVIDE(rw_menu_paged_func_8040A77C_de = 4237224);
PROVIDE(rw_menu_paged_func_8040A7BC_de = 4237288);
PROVIDE(rw_menu_paged_func_8040A83C_us = 4237372);
PROVIDE(rw_menu_paged_func_8040A928_us = 4237608);
PROVIDE(rw_menu_paged_func_8040A9A0_de = 4237856);
PROVIDE(rw_menu_paged_func_8040A9F8_de = 4237944);
PROVIDE(rw_menu_paged_func_8040AA4C_de = 4238028);
PROVIDE(rw_menu_paged_func_8040AAB8_de = 4238136);
PROVIDE(rw_menu_paged_func_8040AAC8_de = 4238152);
PROVIDE(rw_menu_paged_func_8040AADC_de = 4238172);
PROVIDE(rw_menu_paged_func_8040AAF0_de = 4238192);
PROVIDE(rw_menu_paged_func_8040AB04_de = 4238212);
PROVIDE(rw_menu_paged_func_8040AB18_de = 4238232);
PROVIDE(rw_menu_paged_func_8040AB2C_de = 4238252);
PROVIDE(rw_menu_paged_func_8040AB40_de = 4238272);
PROVIDE(rw_menu_paged_func_8040AB54_de = 4238292);
PROVIDE(rw_menu_paged_func_8040ABA0_de = 4238368);
PROVIDE(rw_menu_paged_func_8040ABBC_de = 4238396);
PROVIDE(rw_menu_paged_func_8040ABDC_de = 4238428);
PROVIDE(rw_menu_paged_func_8040ABF0_de = 4238448);
PROVIDE(rw_menu_paged_func_8040AC04_de = 4238468);
PROVIDE(rw_menu_paged_func_8040AC18_de = 4238488);
PROVIDE(rw_menu_paged_func_8040AC2C_de = 4238508);
PROVIDE(rw_menu_paged_func_8040AC40_de = 4238528);
PROVIDE(rw_menu_paged_func_8040AC54_de = 4238548);
PROVIDE(rw_menu_paged_func_8040ACA0_de = 4238624);
PROVIDE(rw_menu_paged_func_8040ADCC_de = 4238924);
PROVIDE(rw_menu_paged_func_8040AEF8_de = 4239224);
PROVIDE(rw_menu_paged_func_8040B024_de = 4239524);
PROVIDE(rw_menu_paged_func_8040B150_de = 4239824);
PROVIDE(rw_menu_paged_func_8040B27C_de = 4240124);
PROVIDE(rw_menu_paged_func_8040B2C8_de = 4240200);
PROVIDE(rw_menu_paged_func_8040B3A8_de = 4240424);
PROVIDE(rw_menu_paged_func_8040B3C4_de = 4240452);
PROVIDE(rw_menu_paged_func_8040B3DC_de = 4240476);
PROVIDE(rw_menu_paged_func_8040B410_de = 4240528);
PROVIDE(rw_menu_paged_func_8040B444_de = 4240580);
PROVIDE(rw_menu_paged_func_8040B4E0_de = 4240736);
PROVIDE(rw_menu_paged_func_8040B58C_de = 4240908);
PROVIDE(rw_menu_paged_func_8040B648_de = 4241096);
PROVIDE(rw_menu_paged_func_8040B6CC_de = 4241228);
PROVIDE(rw_menu_paged_func_8040B700_de = 4241280);
PROVIDE(rw_menu_paged_func_8040B7E0_de = 4241504);
PROVIDE(rw_menu_paged_func_8040B7F8_de = 4241528);
PROVIDE(rw_menu_paged_func_8040B814_de = 4241556);
PROVIDE(rw_menu_paged_func_8040B830_de = 4241584);
PROVIDE(rw_menu_paged_func_8040B84C_de = 4241612);
PROVIDE(rw_menu_paged_func_8040B868_de = 4241640);
PROVIDE(rw_menu_paged_func_8040B8E4_de = 4241764);
PROVIDE(rw_menu_paged_func_8040B960_de = 4241888);
PROVIDE(rw_menu_paged_func_8040B9DC_de = 4242012);
PROVIDE(rw_menu_paged_func_8040BA58_de = 4242136);
PROVIDE(rw_menu_paged_func_8040BAD4_de = 4242260);
PROVIDE(rw_menu_paged_func_8040BBC0_us = 4242368);
PROVIDE(rw_menu_paged_func_8043C4F4_us_rev1_offset_23C = 4441904);
PROVIDE(rw_menu_paged_func_8043C4F4_us_rev1_offset_374 = 4442216);
PROVIDE(rw_menu_paged_func_8043C4F4_us_rev1_offset_684 = 4443000);
PROVIDE(rw_menu_paged_func_8043C4F4_us_rev1_offset_698 = 4443020);
PROVIDE(rw_menu_paged_func_8043C4F4_us_rev1_offset_81C = 4443408);
PROVIDE(rw_menu_paged_func_8043C4F4_us_rev1_offset_8F4 = 4443624);
PROVIDE(rw_menu_paged_func_8043C4F4_us_rev1_offset_8FC = 4443632);
PROVIDE(rw_menu_paged_func_8043C4F4_us_rev1_offset_9BC = 4443824);
PROVIDE(rw_menu_paged_func_8043C4F4_us_rev1_offset_AE4 = 4444120);
PROVIDE(rw_menu_paged_func_8043C4F4_us_rev1_offset_C30 = 4444452);
PROVIDE(rw_menu_paged_func_8043C4F4_us_rev1_offset_DDC = 4444880);
PROVIDE(rw_menu_paged_func_8043C4F4_us_rev1_offset_F48 = 4445244);
PROVIDE(rw_menu_paged_func_8043C4F4_us_rev1_offset_F64 = 4445272);
PROVIDE(rw_menu_paged_func_8043C4F4_us_rev1_offset_FD0 = 4445380);
PROVIDE(rw_menu_paged_func_8043C4F4_us_rev1_offset_FEC = 4445408);
PROVIDE(rw_menu_paged_func_8043D36C_de = 4445516);
PROVIDE(rw_menu_paged_func_8043D388_de = 4445544);
PROVIDE(rw_menu_paged_func_8043D3F4_de = 4445652);
PROVIDE(rw_menu_paged_func_8043D410_de = 4445680);
PROVIDE(rw_menu_paged_func_8043D47C_de = 4445788);
PROVIDE(rw_menu_paged_func_8043D498_de = 4445816);
PROVIDE(rw_menu_paged_func_8043D504_de = 4445924);
PROVIDE(rw_menu_paged_func_8043D520_de = 4445952);
PROVIDE(rw_menu_paged_func_8043D58C_de = 4446060);
PROVIDE(rw_menu_paged_func_8043D5A8_de = 4446088);
PROVIDE(rw_menu_paged_func_8043D614_de = 4446196);
PROVIDE(rw_menu_paged_func_8043D630_de = 4446224);
PROVIDE(rw_menu_paged_func_8043D69C_de = 4446332);
PROVIDE(rw_menu_paged_func_8043D6B8_de = 4446360);
PROVIDE(rw_menu_paged_func_8043D724_de = 4446468);
PROVIDE(rw_menu_paged_func_8043D740_de = 4446496);
PROVIDE(rw_menu_paged_func_8043D7AC_de = 4446604);
PROVIDE(rw_menu_paged_func_8043D7C8_de = 4446632);
PROVIDE(rw_menu_paged_func_8043D834_de = 4446740);
PROVIDE(rw_menu_paged_func_8043D850_de = 4446768);
PROVIDE(rw_menu_paged_func_8043D8BC_de = 4446876);
PROVIDE(rw_menu_paged_func_8043D8D8_de = 4446904);
PROVIDE(rw_menu_paged_func_8043D944_de = 4447012);
PROVIDE(rw_menu_paged_func_8043D960_de = 4447040);
PROVIDE(rw_menu_paged_func_8043D9CC_de = 4447148);
PROVIDE(rw_menu_paged_func_8043D9E8_de = 4447176);
PROVIDE(rw_menu_paged_func_8043DA54_de = 4447284);
PROVIDE(rw_menu_paged_func_8043DA70_de = 4447312);
PROVIDE(rw_menu_paged_func_8043DADC_de_offset_4 = 4447424);
PROVIDE(rw_menu_paged_func_8043DB04_de = 4447460);
PROVIDE(rw_menu_paged_func_8043DD2C_us_rev1_offset_4 = 4447536);
PROVIDE(rw_menu_paged_func_8043E1C0_de = 4448844);
PROVIDE(rw_menu_paged_func_8043E1F8_de = 4448900);
PROVIDE(rw_menu_paged_func_8043E254_de = 4448992);
PROVIDE(rw_menu_paged_func_8043E28C_de = 4449048);
PROVIDE(rw_menu_paged_func_8043E2D8_de = 4449124);
PROVIDE(rw_menu_paged_func_8043E3CC_de = 4449368);
PROVIDE(rw_menu_paged_func_8043E418_de = 4449444);
PROVIDE(rw_menu_paged_func_8043E444_de = 4449488);
PROVIDE(rw_menu_paged_func_8043E468_de = 4449524);
PROVIDE(rw_menu_paged_func_8043E494_de = 4449568);
PROVIDE(rw_menu_paged_func_8043E4E0_de = 4449644);
PROVIDE(rw_menu_paged_func_8043E504_de = 4449680);
PROVIDE(rw_menu_paged_func_8043E530_de = 4449724);
PROVIDE(rw_menu_paged_func_8043E568_de = 4449780);
PROVIDE(rw_menu_paged_func_8043E5C8_de = 4449876);
PROVIDE(rw_menu_paged_func_8043E5D0_de = 4450120);
PROVIDE(rw_menu_paged_func_8043E5D8_de = 4450128);
PROVIDE(rw_menu_paged_func_8043E610_de = 4450184);
PROVIDE(rw_menu_paged_func_8043E658_de = 4450256);
PROVIDE(rw_menu_paged_func_8043E830_de = 4450728);
PROVIDE(rw_menu_paged_func_8043E91C_de = 4450964);
PROVIDE(rw_menu_paged_func_8043E948_de = 4451008);
PROVIDE(rw_menu_paged_func_8043E97C_de = 4451060);
PROVIDE(rw_menu_paged_func_8043E9A8_de = 4451104);
PROVIDE(rw_menu_paged_func_8043EA00_de = 4451192);
PROVIDE(rw_menu_paged_func_8043EA4C_de = 4451268);
PROVIDE(rw_menu_paged_func_8043EA98_de = 4451344);
PROVIDE(rw_menu_paged_func_8043EB70_de = 4451560);
PROVIDE(rw_menu_paged_func_8043EBE4_de = 4451676);
PROVIDE(rw_menu_paged_func_8043EC40_de = 4451768);
PROVIDE(rw_menu_paged_func_8043EC6C_de = 4451812);
PROVIDE(rw_menu_paged_func_8043EC98_de = 4451856);
PROVIDE(rw_menu_paged_func_8043ECC4_de = 4451900);
PROVIDE(rw_menu_paged_func_8043EDDC_de = 4452172);
PROVIDE(rw_menu_paged_func_8043EE24_de = 4452244);
PROVIDE(rw_menu_paged_func_8043EF1C_us_rev1_offset_4 = 4452128);
PROVIDE(rw_menu_paged_func_8043F37C_eu = 4449884);
PROVIDE(rw_menu_paged_func_804402DC_de = 4457548);
PROVIDE(rw_menu_paged_func_80440838_de = 4458920);
PROVIDE(rw_menu_paged_func_804415F4_de = 4462436);
PROVIDE(rw_menu_paged_func_80442064_de = 4465108);
PROVIDE(rw_menu_paged_func_8044208C_de = 4465148);
PROVIDE(rw_menu_paged_func_80442384_de = 4465908);
