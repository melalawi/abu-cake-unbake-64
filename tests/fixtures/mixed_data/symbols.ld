PROVIDE(D_800C9224_de = 0x800CE474);
PROVIDE(D_800CD738 = 0x800D2988);
PROVIDE(D_80142233 = 0x801462F3);
PROVIDE(D_80142834 = 0x801468F4);
PROVIDE(D_801462E5 = 0x801462E5);
PROVIDE(func_8021E08C_de = 0x8021E068);
PROVIDE(func_802A23B4_de = 0x802A33AC);
PROVIDE(func_802A9234_de = 0x802AA224);
